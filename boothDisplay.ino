//#define PxMATRIX_double_buffer true
#include <PxMatrix.h>
#include <functional>
using namespace std;
  
#define P_LAT 22
#define P_A 19
#define P_B 23
#define P_C 18
#define P_D 5
#define P_E 15
#define P_OE 16
hw_timer_t * timer = NULL;
portMUX_TYPE timerMux = portMUX_INITIALIZER_UNLOCKED;

#define MAT_SIZE 64
#define BLACK 0
#define WHITE 65535
#define RED display.color565(255,0,0)
#define BLUE display.color565(0, 0,255)
#define GREEN display.color565(0,255,0)

// This defines the 'on' time of the display is us. The larger this number,
// the brighter the display. If too large the ESP will crash
uint8_t display_draw_time=10; //30-70 is usually fine
const uint16_t LOGO[64*64] = {55336, 55336, 55336, 55336, 55336, 55336, 55336, 55336, 55336, 55336, 55336, 55336, 55336,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 55336, 55336};
int grid[64][64];
int newGrid[64][64]; // globaly scoped to save memory

PxMATRIX display(64,64,P_LAT, P_OE,P_A,P_B,P_C,P_D,P_E);

const uint16_t RGB[3] = {RED, GREEN, BLUE};

void IRAM_ATTR display_updater(){
  // Increment the counter and set the time of ISR
  portENTER_CRITICAL_ISR(&timerMux);
  display.display(display_draw_time);
  portEXIT_CRITICAL_ISR(&timerMux);
}

void display_update_enable(bool is_enable){
  if (is_enable){
    timer = timerBegin(0, 80, true);
    timerAttachInterrupt(timer, &display_updater, true);
    timerAlarmWrite(timer, 4000, true);
    timerAlarmEnable(timer);
  }else{
    timerDetachInterrupt(timer);
    timerAlarmDisable(timer);
  }
}

void setup() {
  Serial.begin(9600);
  display.begin(32);
  display.clearDisplay();
  display_update_enable(true);
  delay(4000);
}

const int ANIMATION_COUNT = 7;
const function<void()> ANIMATIONS[ANIMATION_COUNT] = {&astroid, &tree,  &wolfFrame, &toothpaste, &gameOfLife, &rockPaperSis, &curve };
void loop() {
  times(ANIMATION_COUNT, [](int a) {
    logo();
    ANIMATIONS[a]();
  });
}

void logo(){
  for(int x=0; x<MAT_SIZE; x++){
    for(int y=0; y<MAT_SIZE; y++){
      if(y % 2 == 0)
        display.drawPixel(x, y, LOGO[y*64+x]);
      else 
        display.drawPixel(63 - x, y, LOGO[y*64 + 63 - x]); 
    }
    delay(10);
   }
    delay(1000);
   times(MAT_SIZE, [](int i){
    int x1 = i;
    int y1 = i;
    int x2 = 63 - i;
    int y2 = 63 - i;
    display.drawLine(x1,y1,x1,y2,BLACK);
    display.drawLine(x1,y1,x2,y1,BLACK);
    display.drawLine(x1,y2,x2,y2,BLACK);
    display.drawLine(x2,y1,x2,y2,BLACK);
    delay(10);
   });
}

void ant(){
  int ant[2] = {31, 31};
  int dir[2] = {1, 0};
  int tmp;
  mapGrid(grid, []() -> int{ return 0; });
  
  while(1){
    tmp = dir[1] * -1;
    dir[1] = dir[0];
    dir[0] = tmp;
    if(grid[ant[0]][ant[1]]){
      dir[0] *= -1;
      dir[1] *= -1;
    }
    grid[ant[0]][ant[1]] = !grid[ant[0]][ant[1]];
    ant[0] = (ant[0] + dir[0] + 64) % 64;
    ant[1] = (ant[1] + dir[1] + 64) % 64;
    forEachGrid(grid, [&](int val, int x, int y){ display.drawPixel(x, y, grid[x][y] ? WHITE : BLACK); });
    display.drawPixel(ant[0], ant[1], RED );
    delay(20);
  }
}

void astroid(){
  const int SIZE = 200;
  const int AMOUNT = 5;
  float point[2];
  for(int b = 9; b > 0; b-=1)
  for(int i=0; i<SIZE; i++){
    float t = 2*PI*i/SIZE;
    point[0] = 3*b*cos(t) + b*cos(3*t);
    point[1] = 3*b*sin(t) - b*sin(3*t);
    for(int n=0; n < AMOUNT; n++){
      display.drawPixel(
        (int) point[0] + 31,
        (int) point[1] + 31,
        RGB[b % 3]);
      rotatePoint(point, PI*0.5/AMOUNT);
    }
    delay(10);
  }
}

void tree(){
  branch(30, 63, 32, 0.5 * PI, 0);
  delay(500);
  branch(14, 63, 16, 0.5 * PI, 0);
  delay(500);
  branch(45, 63, 16, 0.5 * PI, 0);
  delay(500);
  branch(6, 63, 9, 0.5 * PI, 0);
  delay(500);
  branch(52, 63, 9, 0.5 * PI, 0);
  delay(500);
  branch(23, 63, 9, 0.5 * PI, 0);
  delay(500);
  branch(38 , 63, 9, 0.5 * PI, 0);
  delay(1000);
  
}

#define ROTATION (PI/5)
#define LEN_CUT 0.5
void branch(float x, float y, int len, float rad, int darkness){
  float point[2] = {len, 0};
  if(len > 1){
    rotatePoint(point, rad);
    display.drawLine(x, y, x + point[0], y + point[1], display.color565(0 , darkness, 255));
    delay(5);
    for(int i=-2; i<3; i++)
      branch(x + point[0], y + point[1], len * LEN_CUT, rad + ROTATION*i, darkness + 15);
  }
}

void curve(){
  const int SIZE = 100;
  float point[2];
  for (int CURVES = 2; CURVES< 10; CURVES*=2){
  display.clearDisplay();
  for(int i=0; i<SIZE; i++){
    float piSlice = PI * 2 * i / (float)SIZE;
    point[0] = 31 * sin(piSlice);
    point[1] = 31 * sin(piSlice) * cos(piSlice);
    for(int c=0; c<CURVES; c++){
      display.drawPixel((int)point[0] + 31,(int)point[1] + 31, WHITE);
      rotatePoint(point,PI/CURVES); 
    }
    delay(10 + CURVES );
  }
  }
}

void toothpaste(){
  const int SIZE = 100;
  const int CURVES = 20;
  float point[2];
  for(int i=0; i<SIZE; i++){
    float piSlice = PI * 2 * i / (float)SIZE;
    point[0] = 31 * sin(piSlice);
    point[1] = 31 * sin(piSlice) * cos(piSlice);
    for(int c=0; c<CURVES; c++){
      display.drawPixel((int)point[0] + 31,(int)point[1] + 31, display.color565(255, 255, 255 * c / CURVES));
      rotatePoint(point, (PI/4)/CURVES);
    }
    delay(15);
  }
  delay(500);
  for(int i=0; i<SIZE; i++){
    float piSlice = PI * 2 * i / (float)SIZE;
    point[0] = 31 * sin(piSlice);
    point[1] = 31 * sin(piSlice) * cos(piSlice);
    rotatePoint(point, PI/2);
    for(int c=0; c<CURVES; c++){
      display.drawPixel((int)point[0] + 31,(int)point[1] + 31, display.color565(255 * c / CURVES, 255, 255));
      rotatePoint(point, (PI/4)/CURVES);
    }
    delay(15);
  }
  delay(500);
}

float *rotatePoint(float point[2], float rad){
    float tmp = point[0] * cos(rad) + point[1] * sin(rad);
    point[1] = point[1] * cos(rad) - point[0] * sin(rad);
    point[0] = tmp;
    return point;
}

void gameOfLife(){
  mapGrid(grid, [](int x, int y) -> int { return ((x + y) % 2 == 0); });
  for(int i = 0; i<130 ; i++){
     forEachGrid(grid, [&](int val, int x, int y){ display.drawPixel(x, y, grid[x][y] ? WHITE : BLACK); });
     playRound(grid);
     delay(50);
  }
}
 
void playRound(int grid[64][64]){
  copyToNewGrid();
  mapGrid(grid, [&](int x, int y) -> int { return surviveGOL(x,y,newGrid); });
}

int surviveGOL(int x, int y, int grid[64][64]){
  int adj = adjs(x, y, grid, [](int val) -> bool{ return val; });
  return (adj == 3 || (grid[x][y] && adj == 4));
}

int adjs(int x, int y, int grid[64][64], function<bool(int)> func){
  int count = 0;
  for(int xx = -1; xx < 2; xx++)
    for(int yy = -1; yy < 2; yy++)
      if(inRange(xx+x) && inRange(yy+y) && func(grid[xx+x][yy+y]))
        count++;
  return count;
}

bool inRange(int val){
  return val >= 0 && val < 64;
}

void rockPaperSis(){
  mapGrid(grid, []() -> int {return (int)random(3); });
  times(200, [](){
    forEachGrid(grid, [](int val, int x, int y){
      display.drawPixel(x, y, RGB[val]);
    });
    copyToNewGrid();
    mapGrid(grid, [](int val, int x, int y) -> int{
       if(2 < adjs(x, y, grid, [&](int a) -> bool{ return (a == (val + 1) % 3); }))
        return (val + 1) % 3;
       return val;
    });
    delay(10);
  });
}

void wolfFrame(){
  const int RULE_COUNT = 3;
  const unsigned int RULES[RULE_COUNT] = {110, 30, 90};
  
  for(int s=0; s<3; s++){
    for(int r=0; r<RULE_COUNT; r++){
      if(s == 2){
        mapGrid(grid, [](int x, int y) -> int{ return (y == 0 && x % 3 == 0); });
        r=2;
      }else if(s)
        mapGrid(grid, [](int x, int y) -> int{ return (y == 0); });
      else 
        mapGrid(grid, [](int x, int y) -> int{ return (x==30 && y ==0); });
      for(int y=1; y<64; y++){
        for(int x=0; x<64; x++){
          unsigned int adjs =0;
          for(int xx=-1; xx<2; xx++)
            if(inRange(x+xx) && grid[x+xx][y-1])
              adjs |= (1UL << (xx+1));
          grid[x][y] = (RULES[r] >> adjs) & 1U;
        }
         forEachGrid(grid, [&](int val, int x, int y){ display.drawPixel(x, y, val ? WHITE : BLACK); });
         delay(20);
      }
      forEachGrid(grid, [&](int val, int x, int y){ display.drawPixel(x, y, val ? WHITE : BLACK); });
      delay(100);
    }
  }
}

void copyToNewGrid(){
  mapGrid(newGrid, [&](int x, int y) -> int { return grid[x][y]; });
}

//void forEach(int len, int *a, function<void(int, int)> func){
//  for(int i=0; i<len; i++) func(a[i], i);
//}
//
//void forEach(int len, int *a, function<void(int)> func){
//  forEach(len, a, [&](int val, int i){ func(val) };
//}

void loopRange(int s, int e, function<void(int)>func){
  for(int i=e; i<s; i++) func(i);
}

void loopRange(int s, int e, function<void()>func){
  loopRange(s, e, [&](int i){ func(); });
}

void times(int len, function<void(int)> func){
  for(int i=0; i<len; i++) func(i);
//  loopRange(0, len, [&](int i){ func(i); });
}

void times(int len, function<void()> func){
  times(len, [&](int i) { func(); });
}

void forEachGrid(int grid[64][64], function<void(int, int, int)> func){
  for(int x=0; x<64; x++) for(int y=0; y<64; y++) func(grid[x][y],x,y);
}

void forEachGrid(int grid[64][64], function<void(int)> func){
  forEachGrid(grid, [&](int val, int x, int y) { func(val); });
}

void mapGrid(int grid[64][64], function<int(int, int, int)> func){
  forEachGrid(grid, [&](int val, int x, int y){ grid[x][y] = func(val, x, y); });
}

void mapGrid(int grid[64][64], function<int(int, int)> func){
  mapGrid(grid, [&](int val, int x, int y) { return func(x, y); });
}

void mapGrid(int grid[64][64], function<int(int)> func){
  mapGrid(grid, [&](int val, int x, int y) -> int{ return func(val); });
}

void mapGrid(int grid[64][64], function<int()> func){
  mapGrid(grid, [&](int x, int y) -> int{ return func(); });
}
